/dts-v1/;
/plugin/;

/ {
    compatible = "radxa,zero3", "radxa,zero-3w", "rockchip,rk3566";

    fragment@0 {
        target = <&i2c4>;
        __overlay__ {
            #address-cells = <1>;
            #size-cells = <0>;
            pinctrl-0 = <&i2c4m0_xfer>;
            pinctrl-names = "default";
            status = "okay";

            picocalckbd@1f {
                compatible = "picocalc_kbd";
                reg = <0x1f>;
            };
        };
    };
};

